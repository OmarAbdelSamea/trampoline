AUTOSAR XML (schema 4-0-1)
package /Os
  module definition OsImplementation  # Fixes the default Stacksize
    container TASK  # Fixes TASKS' default STACKSIZE
      integer stacksize: default-value=1000
    container ISR  # Fixes ISRS' default STACKSIZE
      integer stacksize: default-value=200
package /CPU
  ecuc value collection v2x: ecuc-values=config
  module config config: definition=Os
    OsOS: OsPostTaskHook=false, OsPreTaskHook=false, OsStatus=EXTENDED, OsPaint_Stack=false, OsPaint_Registers=false, OsSystem_Call=true
      true (OsBuild):
        OsTrampoline_Base_Path = ../../../../../..
        OsApp_Src = v2x.c
        OsApp_Name = v2x_exe
        OsCompiler = arm-none-eabi-gcc
        OsAssembler = arm-none-eabi-as
        OsLinker = arm-none-eabi-ld
        OsCopier = arm-none-eabi-objcopy
        OsSystem = PYTHON
        OsLibrary = V2X
      true (OsMemmap): OsCompiler=gcc, OsAssembler=gnu_as, OsMemory_Protection=false
        gnu_ld (OsLinker): OsScript=script.ld
    OsAppMode
    3 x OsAlarm, all with OsAlarmCounterRef=SystemCounter:
      Alarm_1ms
        ACTIVATETASK (OsAlarmAction): OsAlarmTaskRef=Task_1ms
        true (OsAlarmAutostart): OsAlarmAppModeRef=OsAppMode, OsAlarmAlarmtime=1, OsAlarmCycletime=1
      Alarm_50ms
        ACTIVATETASK (OsAlarmAction): OsAlarmTaskRef=Task_50ms
        true (OsAlarmAutostart): OsAlarmAppModeRef=OsAppMode, OsAlarmAlarmtime=50, OsAlarmCycletime=50
      Alarm_100ms
        ACTIVATETASK (OsAlarmAction): OsAlarmTaskRef=Task_100ms
        true (OsAlarmAutostart): OsAlarmAppModeRef=OsAppMode, OsAlarmAlarmtime=100, OsAlarmCycletime=100
    3 x OsTask, all with OsTaskPriority=1, OsTaskActivation=1, OsTaskAutostart=false, OsTaskSchedule=FULL:
      Task_1ms
      Task_50ms
      Task_100ms
    isr_tim4 (OsIsr): OsIsrSource=TIM4_IRQ, OsIsrCategory=1, OsIsrPriority=1
